## main/Kconfig.projbuild
```kconfig
menu "WiFi Configuration"

config WIFI_SSID
    string "WiFi SSID"
    default ""

config WIFI_PASSWORD
    string "WiFi Password"
    default ""

endmenu

menu "ElevenLabs TTS Configuration"

config ELEVENLABS_API_KEY
    string "ElevenLabs API Key"
    default ""
    help
        Your ElevenLabs API key. Get it from https://elevenlabs.io

config ELEVENLABS_VOICE_ID
    string "ElevenLabs Voice ID"
    default "XrbmwOihWOLSrRLvMXGE"
    help
        The voice ID to use for TTS. Default is a preset voice.

endmenu

menu "OpenAI TTS Configuration"

config OPENAI_API_KEY
    string "OpenAI API Key"
    default ""
    help
        Your OpenAI API key. Get it from https://platform.openai.com/api-keys

config OPENAI_TTS_MODEL
    string "OpenAI TTS Model"
    default "tts-1"
    help
        The TTS model to use. Options: tts-1 (faster), tts-1-hd (quality), gpt-4o-mini-tts (newest)

config OPENAI_TTS_VOICE
    string "OpenAI TTS Voice"
    default "alloy"
    help
        The voice to use. Options: alloy, echo, fable, onyx, nova, shimmer, coral

endmenu

menu "Deepgram Live STT Configuration"

config DEEPGRAM_API_KEY
    string "Deepgram API Key"
    default ""
    help
        Your Deepgram API key for real-time speech-to-text.
        Get a free key at https://console.deepgram.com

endmenu
```

## sdkconfig.defaults
```kconfig
# ESP32-P4 WiFi + Audio Configuration

# Target
CONFIG_IDF_TARGET="esp32p4"

# Flash
CONFIG_ESPTOOLPY_FLASHMODE_QIO=y
CONFIG_ESPTOOLPY_FLASHSIZE_16MB=y
CONFIG_PARTITION_TABLE_CUSTOM=y
CONFIG_PARTITION_TABLE_CUSTOM_FILENAME="partitions.csv"

# PSRAM (required for audio buffering)
CONFIG_SPIRAM=y
CONFIG_SPIRAM_SPEED_200M=y

# Performance
CONFIG_COMPILER_OPTIMIZATION_PERF=y
CONFIG_FREERTOS_HZ=1000

# FAT filesystem for SD card
CONFIG_FATFS_LFN_HEAP=y

# Audio player settings
CONFIG_AUDIO_PLAYER_ENABLE_MP3=y
CONFIG_AUDIO_PLAYER_ENABLE_WAV=y

# Experimental features (required for ESP32-P4)
CONFIG_IDF_EXPERIMENTAL_FEATURES=y

# HTTPS certificate bundle (required for ElevenLabs TTS)
CONFIG_MBEDTLS_CERTIFICATE_BUNDLE=y
CONFIG_MBEDTLS_CERTIFICATE_BUNDLE_DEFAULT_FULL=y
```
